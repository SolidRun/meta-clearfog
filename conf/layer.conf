## conf/layer.conf
```bitbake
# We have a conf and classes directory, append to BBPATH
BBPATH .= ":${LAYERDIR}"

# We have a recipes directory containing .bb and .bbappend files, add to BBFILES
BBFILES += "${LAYERDIR}/recipes*/*/*.bb \
            ${LAYERDIR}/recipes*/*/*.bbappend"

BBFILE_COLLECTIONS += "clearfog"
BBFILE_PATTERN_clearfog := "^${LAYERDIR}/"

LAYERSERIES_COMPAT_clearfog = "warrior"
```

## conf/machine/clearfog-gtr-l8.conf
```bitbake
include conf/machine/clearfog.conf

UBOOT_EXTLINUX_FDT = "../armada-385-clearfog-gtr-l8.dtb"
```

## conf/machine/clearfog.conf
```bitbake
include conf/machine/include/tune-cortexa9.inc

DEFAULTTUNE_armada38x ?= "armv7ahf-neon"

MACHINEOVERRIDES =. "armada38x:"

UBOOT_MACHINE = "clearfog_defconfig"
UBOOT_BINARY = "u-boot-spl.kwb"
UBOOT_EXTLINUX = "1"
UBOOT_EXTLINUX_ROOT = "root=/dev/mmcblk0p1"
UBOOT_EXTLINUX_CONSOLE = "console=${console}"
do_image_wic[depends] += "u-boot:do_populate_sysroot virtual/kernel:do_deploy"

PREFERRED_PROVIDER_virtual/kernel = "linux-yocto-clearfog"
KBUILD_DEFCONFIG_armada38x = "mvebu_v7_defconfig"

IMAGE_INSTALL_append = " \
	u-boot \
	kernel-devicetree \
	kernel-image-zimage \
	kernel-modules \
	"

SERIAL_CONSOLE = "115200;ttyS0"

IMAGE_FSTYPES ?= "tar.bz2 ext4 wic"

WKS_FILE ?= "sdimage-clearfog.wks"
```

## wic/sdimage-clearfog.wks
```
part u-boot --source rawcopy --sourceparams="file=u-boot-spl.kwb" --ondisk mmcblk --no-table --align 0
part / --source rootfs --ondisk mmcblk --fstype=ext4 --label root --align 4096
```
